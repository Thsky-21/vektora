## SIH26172-Vektora/extras/oled_test/main/Kconfig.projbuild
```kconfig
menu "Vektora OLED CPU test"

    config OLED_I2C_SDA_GPIO
        int "OLED SDA GPIO"
        default 21
        help
            Confirmed wiring, 2026-09-28: SDA -> GPIO21.

    config OLED_I2C_SCL_GPIO
        int "OLED SCL GPIO"
        default 22
        help
            Confirmed wiring, 2026-09-28: SCL -> GPIO22.

    config OLED_I2C_ADDR
        hex "SSD1306 7-bit I2C address"
        default 0x3C
        help
            0x3C on almost every 0.96" SSD1306 module. A few boards are
            wired to 0x3D instead (check the module's silkscreen/datasheet
            if the display stays blank).

    config OLED_ARENA_KB
        int "TFLite Micro tensor arena, upper bound (KB)"
        default 128
        help
            Upper bound only — main.cc clamps this to the largest free
            contiguous heap block minus a safety margin at boot, exactly
            like prototype/firmware. The Run 3 model measured 80,656 bytes
            used on the real board (CLAUDE.md §12.5), so 128 KB leaves
            headroom without wasting the whole 160 KB the first attempt used.

endmenu
```

## SIH26172-Vektora/extras/recorder/firmware/main/Kconfig.projbuild
```kconfig
menu "Vektora recorder"

    config VKR_I2S_SCK_GPIO
        int "INMP441 SCK (bit clock) GPIO"
        default 6
        help
            ESP32-S3: GPIO 6 is fine. Plain ESP32 (WROOM-32): never use
            GPIO 6-11, they are the internal SPI flash bus.

    config VKR_I2S_WS_GPIO
        int "INMP441 WS (word select / LRCL) GPIO"
        default 5

    config VKR_I2S_SD_GPIO
        int "INMP441 SD (data out) GPIO"
        default 4

    config VKR_I2S_RIGHT_CHANNEL
        bool "INMP441 L/R pin is tied to VDD (right channel)"
        default n

    config VKR_SAMPLE_SHIFT
        int "Right shift from 32-bit I2S sample to 16-bit"
        range 8 20
        default 16
        help
            MUST equal CONFIG_VK_SAMPLE_SHIFT in the keyword-spotter
            firmware, so the recordings have exactly the level the model
            will hear on the device. The value is sent in every packet and
            written into the recording log by record.py.

    config VKR_USE_USB_JTAG
        bool "Stream over the chip's native USB port (USB-Serial-JTAG)"
        depends on SOC_USB_SERIAL_JTAG_SUPPORTED
        default y
        help
            ESP32-S3 / C3 / C6: the board's "USB" connector. Turn off to
            stream over UART0 instead (the board's "UART" connector, via its
            USB-to-UART bridge). The plain ESP32 has no native USB, so it
            always uses UART0.

    config VKR_BAUD
        int "UART0 baud rate for the audio stream"
        default 921600
        help
            Only used when streaming over UART0. 16 kHz x 16 bit = 32 kB/s of audio plus ~6% framing. 921600 baud
            carries ~92 kB/s, so there is almost 3x headroom.

    config VKR_LED_GPIO
        int "Heartbeat LED GPIO (-1 = none)"
        default -1
        help
            Off by default. On an ESP32 DevKit V1, 2 is the blue on-board LED
            (blinks once per second while streaming). ESP32-S3 DevKits have an
            addressable RGB LED instead, which a plain GPIO cannot drive. Do NOT use GPIO 4 here: it is the mic's SD
            line on this rig.

endmenu
```

## SIH26172-Vektora/firmware/main/Kconfig.projbuild
```kconfig
menu "Vektora keyword spotter"

    config VK_I2S_SCK_GPIO
        int "INMP441 SCK (bit clock) GPIO"
        default 26
        help
            Must match the board wiring. Unconfirmed default.

    config VK_I2S_WS_GPIO
        int "INMP441 WS (word select / LRCL) GPIO"
        default 25

    config VK_I2S_SD_GPIO
        int "INMP441 SD (data out) GPIO"
        default 33
        help
            Input only is fine (GPIO 34-39 work too).

    config VK_I2S_RIGHT_CHANNEL
        bool "INMP441 L/R pin is tied to VDD (right channel)"
        default n
        help
            Leave off when L/R is tied to GND, which is the usual wiring.

    config VK_SAMPLE_SHIFT
        int "Right shift from 32-bit I2S sample to 16-bit"
        range 8 20
        default 16
        help
            The INMP441 sends 24-bit audio left-aligned in a 32-bit slot.
            A shift of 16 keeps the top 16 bits (full scale = full scale).
            A smaller shift adds 6 dB of gain per step. This MUST match the
            conversion used when the training data was recorded, because the
            model uses no volume normalisation. Compare the "level" printed
            in the log with the training clips' level.

    config VK_LED_GPIO
        int "Detection LED GPIO (-1 = none)"
        default 2
        help
            GPIO 2 is the blue on-board LED of the DevKit V1.

    config VK_INFER_EVERY_FRAMES
        int "Run the model every N 10 ms frames"
        range 1 50
        default 10
        help
            10 = every 100 ms, the same 0.1 s hop the tester UI uses.

    config VK_REFRACTORY_MS
        int "Ignore new detections for this long after one (ms)"
        default 1500

    config VK_LOG_SCORE_MIN
        int "Log every inference whose P(keyword) is at least this (percent)"
        range 0 100
        default 20

    config VK_ARENA_KB
        int "TFLite Micro tensor arena (KB)"
        default 160
        help
            Working memory for the model. The log prints how much was really
            used; lower this to that plus some margin.

endmenu
```
